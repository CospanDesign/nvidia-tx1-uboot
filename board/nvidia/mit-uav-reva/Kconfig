## board/nvidia/mit-uav-reva/Kconfig
```kconfig
if TARGET_MIT_UAV_REVA

config SYS_BOARD
	default "mit-uav-reva"

config SYS_VENDOR
	default "nvidia"

config SYS_CONFIG_NAME
	default "mit-uav-reva"

endif
```

## board/nvidia/mit-uav-revb/Kconfig
```kconfig
if TARGET_MIT_UAV_REVB

config SYS_BOARD
	default "mit-uav-revb"

config SYS_VENDOR
	default "nvidia"

config SYS_CONFIG_NAME
	default "mit-uav-revb"

endif
```

## configs/mit-uav-reva_defconfig
```kconfig
CONFIG_ARM=y
CONFIG_TEGRA=y
CONFIG_TEGRA210=y
CONFIG_TARGET_MIT_UAV_REVA=y
CONFIG_DEFAULT_DEVICE_TREE="tegra210-mit-uav-reva"
CONFIG_USE_PRIVATE_LIBGCC=n
CONFIG_NVTBOOT=y
CONFIG_CMD_NET=y
```
